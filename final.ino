


//PIN NEOPIXEL

//PIN PIR

//PIN BUTTON

//PIN OLED

//PIN SERVO

#include <EEPROM.h>
#include <Adafruit_NeoPixel.h>
#include <Servo.h>
#include <NTPClient.h>
#include <ESP8266WiFi.h>
#include <WiFiUdp.h>
#include <Adafruit_NeoPixel.h>

#include <SoftwareSerial.h>
#include <JQ6500_Serial.h>
JQ6500_Serial mp3(3,1);

#include <U8g2lib.h>
#ifdef U8X8_HAVE_HW_SPI
#include <SPI.h>
#endif
#ifdef U8X8_HAVE_HW_I2C
#include <Wire.h>
#endif

//mode i2c hardware
U8G2_SSD1306_128X64_NONAME_F_HW_I2C u8g2(U8G2_R0, /* reset=*/ U8X8_PIN_NONE);

static const unsigned char MDlogo[] = {
  0x00, 0x00, 0x00, 0x00, 0x00, 0x00, 0x00, 0x00, 0x00, 0x00, 0x00, 0x00, 
  0x00, 0x00, 0x00, 0x00, 0x00, 0x00, 0x00, 0x00, 0x00, 0x00, 0x00, 0x00, 
  0x00, 0x00, 0x00, 0x00, 0x00, 0x00, 0x00, 0x00, 0x00, 0x00, 0x00, 0x00, 
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  0x00, 0x00, 0x00, 0x00, };


Servo myservo; 

#define LEDPIN         15
#define NUMPIXELS      1
Adafruit_NeoPixel pixels = Adafruit_NeoPixel(NUMPIXELS, LEDPIN, NEO_RGB + NEO_KHZ800);


const char *ssid     = "MD_net";
const char *password = "curiosityisgood88";
//const long utcOffsetInSeconds = 25200;//WIB
const long utcOffsetInSeconds = 28800;//WITA
//const long utcOffsetInSeconds = 32400;//WIT
String settimezone="WITA";

char daysOfTheWeek[7][12] = {"SUN", "MON", "TUE", "WED", "THU", "FRI", "SAT"};
char alarmaray[49][6] = {"OFF","01:00", "01:30","02:00", "02:30","03:00", "03:30","04:00", "04:30","05:00", "05:30","06:00", "06:30","07:00", "07:30","08:00", "08:30","09:00", "09:30","10:00", "10:30","11:00", "11:30","12:00", "12:30","13:00", "13:30","14:00", "14:30","15:00", "15:30","16:00", "16:30","17:00", "17:30","18:00", "18:30","19:00", "19:30","20:00", "20:30","21:00", "21:30","22:00", "22:30","23:00", "23:30","00:00", "00:30"};
int alarmindex=0;
char timezonenameoption[5][5]={"WITA","WIB","WIT"};
int timezoneoffsetoption[3]={28800,32400,25200};
int timezoneindex=0;

//game
//int gameincrementspeed[11][2] = {0,22,21,20,18,17,16,15,13,12,8};
int gamecycle=0;
int gamecountconts=600;
int gamecountdown=gamecountconts;//(250sec)
int redligthduration=20;
int redligthcoundown=redligthduration;
int gameincrementspeed[11] = {0,22,21,20,18,17,16,15,13,12,8};
int countdownpergamecycle = 0;
int servoposfront=600;
int servoposback=2400;

// Define NTP Client to get time
WiFiUDP ntpUDP;
NTPClient timeClient(ntpUDP, "pool.ntp.org", utcOffsetInSeconds);
int clockcounter=0;
int loopcounter=0;
int alarmsoundonce=0;

int menustate=1;//1.clockdisplay 2.setalarm 3.game
String currenttime="00:00";

void setup(){
  eepromsetup();  
  buttonsetup();
  ledsetup();
  setupmp3();
 // Serial.begin(115200);
  servosetup();
  WiFi.begin(ssid, password);
  while ( WiFi.status() != WL_CONNECTED ) {
    delay ( 500 );
    Serial.print ( "." );
  }

  if(eeGetInt(10)==0 || eeGetInt(10)==1 || eeGetInt(10)==2){
   timezoneindex=eeGetInt(10);
  }
  timeClient.begin();
  inittimezone();
  
  u8g2.begin(); 
  u8g2.clearBuffer();          
  u8g2.drawXBM(0,0, 128, 64, MDlogo);
  u8g2.sendBuffer(); 
  delay(2000);

 // pinMode(14, INPUT_PULLUP);
  pixels.begin();
  ///Serial.println(String(eeGetInt(50)));
  //changetimezone();
  //myservo.writeMicroseconds(servoposback);
  myservo.writeMicroseconds(servoposfront);
}

void loop() {

    if(menustate==1){//clock
       if (digitalRead(0) == LOW ){//go to game
        menustate=3;
        while(digitalRead(0) == LOW){}
       }else  if (digitalRead(2) == LOW ){//go to alarm set
        menustate=2;
        while(digitalRead(2) == LOW){}
       }else  if (digitalRead(12) == LOW ){//change time zone
        int temp=0;
        while(digitalRead(12) == LOW){temp++;}
        if(temp>5){
          changetimezone();
          //myservo.writeMicroseconds(servoposback);
        }
       }else{}

       if(clockcounter==0){
          updateclockdisplay();
       }
    }else if(menustate==2){//alarm set
      updatealarmmenu();
       if (digitalRead(0) == LOW ){//select the alaem time
        ///Serial.println("button 0");
        while(digitalRead(0) == LOW){}
        setalarmconfirm();
       }else  if (digitalRead(2) == LOW ){//choose the alarm
        ///Serial.println("button 2");
          alarmindex++;
        if(alarmindex==50){
          alarmindex=0;
        }
       }else{}
       
    }else if(menustate==3){//game
       gamecountdown--;
        gamedisplay();
       if (digitalRead(0) == LOW ){//game finish
        ///Serial.println("button 0");
        gamefinish();
        menustate=1;
        gamecountdown=gamecountconts;
        while(digitalRead(0) == LOW){}
       }else  if (digitalRead(2) == LOW ){//exit game
        ///Serial.println("button 2");
        while(digitalRead(2) == LOW){}
       }else{}
       
       
    }

  
  
    if(clockcounter==0){
      clockcounter++;
    }else{
      clockcounter++;
      if(clockcounter==239){
        clockcounter=0;
      }
    }


  
  alarmtriger();
   delay(250);
   loopcounter++;
  
}

void updateclockdisplay(){
  timeClient.update();
  
  String chartemp = twodigitabsolut(timeClient.getHours())+":"+twodigitabsolut(timeClient.getMinutes());
  currenttime=chartemp;
  String chartemp2 = String(daysOfTheWeek[timeClient.getDay()])+" / "+String(settimezone);
  u8g2.clearBuffer();          
  u8g2.setFont(u8g2_font_fub35_tf); 
  //u8g2.drawStr(0,10,"test");  
  //u8g2.print(F("ORIGINAL IN FLASH"));
  u8g2.setCursor(0, 36);
  u8g2.print(chartemp);
  u8g2.setFont(u8g2_font_fub11_tf); 
  u8g2.setCursor(0, 60);
  u8g2.print(chartemp2);
  u8g2.sendBuffer();
  myservo.writeMicroseconds(servoposback);

}

String twodigitabsolut(int temp){
  if(temp<10){
    return "0"+String(temp);
  }else{
    return String(temp);
  }
}

void updatealarmmenu(){
  u8g2.clearBuffer();
  u8g2.setFont(u8g2_font_fub11_tf); 
  u8g2.setCursor(0, 13);
  u8g2.print("SET ALARM");
  u8g2.setFont(u8g2_font_fub35_tf); 
  u8g2.setCursor(0, 60);
  u8g2.print(alarmaray[alarmindex]);
  u8g2.sendBuffer();
}

void setalarmconfirm(){
  u8g2.clearBuffer();
  u8g2.setFont(u8g2_font_fub14_tf); 
  u8g2.setCursor(2, 15);
  u8g2.print("ALARM SET");
  u8g2.setFont(u8g2_font_fub14_tf); 
  u8g2.setCursor(12, 40);
  u8g2.print("TO "+String(alarmaray[alarmindex]));
  u8g2.sendBuffer();
  eeWriteInt(50, alarmindex);
  menustate=1;
  alarmindex=0;
  delay(3000);
  updateclockdisplay();
}

void gamedisplay(){
  
  if(gamecountdown<=gamecountconts && gamecountdown>=(gamecountconts-12)){
    u8g2.clearBuffer();          
    u8g2.setFont(u8g2_font_fub25_tf); 
    u8g2.setCursor(10, 25);
    u8g2.print("GAME");
    u8g2.setCursor(0, 55);
    u8g2.print("START!!");
    u8g2.sendBuffer();
  }else if(gamecountdown<(gamecountconts-12) && gamecountdown>0){
    if(countdownpergamecycle==0){
      if(gamecycle<9){
        gamecycle++;
      }
      countdownpergamecycle=int(gameincrementspeed[gamecycle])+redligthduration;
    }else{
        u8g2.clearBuffer();
        u8g2.setFont(u8g2_font_fub25_tf); 
      if(countdownpergamecycle>redligthduration){//greenlight
        myservo.writeMicroseconds(servoposfront);
        if( countdownpergamecycle==(gameincrementspeed[gamecycle]+redligthduration)){
          playsound(gamecycle);
        }
        u8g2.setCursor(10, 28);
        u8g2.print("MOVE");
        pixels.setPixelColor(0, pixels.Color(50,0,0));
        pixels.show();
      }else{//redlight
        myservo.writeMicroseconds(servoposback);
        if( countdownpergamecycle==redligthduration){
          playsound(10);
        }
        u8g2.setCursor(15, 28);
        u8g2.print("STOP");
        
        if (digitalRead(13) == HIGH ){//if movement detected
          pixels.setPixelColor(0, pixels.Color(0,50,0));
          pixels.show();
          playsound(11);
          gamecountdown=0;
        }else{
          pixels.setPixelColor(0, pixels.Color(0,0,50));
          pixels.show();
        }
      }

        u8g2.setFont(u8g2_font_fub14_tf); 
        u8g2.setCursor(5, 55);
        u8g2.print("COUNT "+String(gamecountdown/4));
        u8g2.sendBuffer();
        //Serial.println(countdownpergamecycle);
      countdownpergamecycle--;
    }

    
  }else if(gamecountdown<=0){
      u8g2.clearBuffer();          
      u8g2.setFont(u8g2_font_fub14_tf); 
      u8g2.setCursor(2, 20);
      u8g2.print("GAME OVER");
      u8g2.setCursor(3, 50);
      u8g2.print("YOU DEATH!");
      u8g2.sendBuffer();
      countdownpergamecycle--;
      if(countdownpergamecycle<=-20){
        menustate=1;
        gamereset();
        updateclockdisplay();
      }
  }
  
}

void gamefinish(){
  u8g2.clearBuffer();          
  u8g2.setFont(u8g2_font_fub20_tf); 
  u8g2.setCursor(18, 25);
  u8g2.print("GAME");
  u8g2.setCursor(8, 55);
  u8g2.print("FINISH!!");
  u8g2.sendBuffer();
  gamereset();
}


void gamereset(){
  gamecycle=0;
  gamecountdown=gamecountconts;//(250sec)
  redligthcoundown=redligthduration;
  countdownpergamecycle=0;
  myservo.writeMicroseconds(servoposback);
}

void initimezone(){
  
}

void changetimezone(){//this code made for indonesia timezoneso if you on other timesone you can change "settimezone" and the settimeoffset in second
  timezoneindex++;
  if(timezoneindex==3){
    timezoneindex=0;
  }

  timeClient.setTimeOffset(timezoneoffsetoption[timezoneindex]);
  settimezone=timezonenameoption[timezoneindex];
  eeWriteInt(10, timezoneindex);
  
  updateclockdisplay();

}

void inittimezone(){
  timeClient.setTimeOffset(timezoneoffsetoption[timezoneindex]);
  settimezone=timezonenameoption[timezoneindex];
  updateclockdisplay();
}

void buttonsetup(){
  pinMode(0, INPUT_PULLUP);
  pinMode(2, INPUT_PULLUP);
  pinMode(12, INPUT_PULLUP);
}

void pirsetup(){
  pinMode(13, INPUT);
}

void servosetup(){
  myservo.attach(14);
  delay(1000);
  
  
   //myservo.writeMicroseconds(600);
   delay(5000);
  // myservo.writeMicroseconds(2400);
    

}

void servotest(){
  if(loopcounter%8==0){
    myservo.write((((loopcounter/8)%18)*10));
    ///Serial.println(String(((loopcounter/8)%18)*10));
  }
}

void ledsetup(){
   pixels.begin();
}

void eepromsetup(){
  EEPROM.begin(512);
}

void eeWriteInt(int pos, int val) {
    byte* p = (byte*) &val;
    EEPROM.write(pos, *p);
    EEPROM.write(pos + 1, *(p + 1));
    EEPROM.write(pos + 2, *(p + 2));
    EEPROM.write(pos + 3, *(p + 3));
    EEPROM.commit();
}

int eeGetInt(int pos) {
  int val;
  byte* p = (byte*) &val;
  *p        = EEPROM.read(pos);
  *(p + 1)  = EEPROM.read(pos + 1);
  *(p + 2)  = EEPROM.read(pos + 2);
  *(p + 3)  = EEPROM.read(pos + 3);
  return val;
}

void alarmtriger(){
  
  if(currenttime==String(alarmaray[eeGetInt(50)])){
    if(loopcounter%3==1){
      pixels.setPixelColor(0, pixels.Color(0,0,50));
    }else if(loopcounter%3==2){
      pixels.setPixelColor(0, pixels.Color(0,50,0));
    }else if(loopcounter%3==0){
      pixels.setPixelColor(0, pixels.Color(50,0,0));
    }

    if(loopcounter%10==0){
      myservo.writeMicroseconds(servoposfront);
    }else if(loopcounter%10==5){
      myservo.writeMicroseconds(servoposback);
    }

    if(alarmsoundonce==0){
      playsound(12);
      alarmsoundonce=1;
    }

    if (digitalRead(0) == LOW || digitalRead(2) == LOW || digitalRead(12) == LOW ){
      mp3.pause();
      eeWriteInt(50,0);
    }
  }else{
    pixels.setPixelColor(0, pixels.Color(0,0,0));
    alarmsoundonce=0;
  }
  pixels.show();
}

void setupmp3(){
  mp3.begin(9600);
  mp3.reset();
  mp3.setVolume(20);
  mp3.setLoopMode(MP3_LOOP_NONE);
}

void playsound(int mp3index){
   mp3.playFileByIndexNumber(mp3index);  
}
